/*==============================================================================
 * AD9554 简化版本使用示例
 * 
 * 本示例展示了简化后的AD9554驱动的使用方法
 * 驱动已移除寄存器操作模式，统一使用HAL API
 *============================================================================*/

#include "AD9554.h"

/*==============================================================================
 * 示例1：基本初始化和频率设置
 *============================================================================*/
void AD9554_SimpleExample(void)
{
    // 初始化AD9554（自动进行GPIO配置）
    AD9554_Init();
    
    // 设置输出频率为1MHz
    AD9554_SetFrequency(1000000.0);
    
    // 设置幅度为75%
    AD9554_SetAmplitude(0x3000);
    
    // 设置相位为0度
    AD9554_SetPhase(0);
}

/*==============================================================================
 * 示例2：GPIO引脚配置验证
 *============================================================================*/
void AD9554_GPIOTest(void)
{
    // 手动初始化GPIO（可选，AD9554_Init会自动调用）
    AD9554_GPIO_Init();
    
    // 测试所有控制引脚
    AD9554_SPI_CS_HIGH();
    HAL_Delay(100);
    AD9554_SPI_CS_LOW();
    HAL_Delay(100);
    
    AD9554_SPI_SCLK_HIGH();
    HAL_Delay(100);
    AD9554_SPI_SCLK_LOW();
    HAL_Delay(100);
    
    AD9554_SPI_SDIO_HIGH();
    HAL_Delay(100);
    AD9554_SPI_SDIO_LOW();
    HAL_Delay(100);
    
    // 测试复位功能
    AD9554_Reset();
}

/*==============================================================================
 * 示例3：频率扫描（简化版）
 *============================================================================*/
void AD9554_FrequencySweepSimple(void)
{
    double frequency;
    
    // 初始化
    AD9554_Init();
    
    // 固定幅度
    AD9554_SetAmplitude(0x3FFF);
    
    // 简单的频率扫描
    for (frequency = 100000.0; frequency <= 1000000.0; frequency += 50000.0)
    {
        AD9554_SetFrequency(frequency);
        HAL_Delay(200);
    }
}

/*==============================================================================
 * 示例4：使用扫描模式
 *============================================================================*/
void AD9554_ScanModeExample(void)
{
    // 初始化
    AD9554_Init();
    
    // 设置基础参数
    AD9554_SetFrequency(500000.0);
    AD9554_SetAmplitude(0x2000);
    
    // 测试不同扫描模式
    AD9554_SetScanMode(AD9554_SCAN_UP);
    HAL_Delay(1000);
    
    AD9554_SetScanMode(AD9554_SCAN_DOWN);
    HAL_Delay(1000);
    
    AD9554_SetScanMode(AD9554_SCAN_DOUBLE);
    HAL_Delay(1000);
}

/*==============================================================================
 * 示例5：错误处理示例
 *============================================================================*/
void AD9554_ErrorHandlingExample(void)
{
    // 初始化
    AD9554_Init();
    
    // 幅度会自动限制在有效范围内
    AD9554_SetAmplitude(0x5000);  // 会被限制到0x3FFF
    
    // 频率转换测试
    uint32_t ftw = AD9554_FrequencyToFTW(1000000.0);
    double freq_back = AD9554_FTWToFrequency(ftw);
    
    // 验证转换精度
    if (freq_back >= 999999.0 && freq_back <= 1000001.0)
    {
        // 转换成功，误差在1Hz以内
        AD9554_SetFrequency(freq_back);
    }
}

/*==============================================================================
 * 示例6：应用集成示例
 *============================================================================*/
void AD9554_ApplicationExample(void)
{
    // 系统初始化
    HAL_Init();
    SystemClock_Config();  // 用户需要实现此函数
    
    // AD9554初始化
    AD9554_Init();
    
    // 设置初始参数
    AD9554_SetFrequency(1000000.0);    // 1MHz
    AD9554_SetAmplitude(0x3000);       // 75%幅度
    AD9554_SetPhase(0);                // 0度相位
    
    // 主循环
    while (1)
    {
        // 应用逻辑
        // 可以根据需要调整频率、幅度等参数
        
        // 示例：每隔5秒改变一次频率
        static uint32_t last_time = 0;
        static double frequencies[] = {1000000.0, 1500000.0, 2000000.0, 2500000.0};
        static uint8_t freq_index = 0;
        
        if (HAL_GetTick() - last_time > 5000)
        {
            AD9554_SetFrequency(frequencies[freq_index]);
            freq_index = (freq_index + 1) % 4;
            last_time = HAL_GetTick();
        }
        
        HAL_Delay(100);
    }
}


/*==============================================================================
 * 延时函数实现示例
 *============================================================================*/
void AD9554_DelayMs(uint32_t ms)
{
    HAL_Delay(ms);
}

void AD9554_DelayUs(uint32_t us)
{
    // 简单的微秒延时实现
    volatile uint32_t count = us * (SystemCoreClock / 1000000U) / 10U;
    while (count--)
    {
        __NOP();
    }
}

/*==============================================================================
 * 使用说明
 *============================================================================*/
/*
 * 使用简化版AD9554驱动的步骤：
 * 
 * 1. 在AD9554.h中配置正确的GPIO引脚定义
 * 2. 在CubeMX中配置对应的GPIO为输出模式
 * 3. 确保GPIO时钟已使能
 * 4. 调用AD9554_Init()进行初始化
 * 5. 使用AD9554_SetFrequency()等函数设置参数
 * 
 * 注意事项：
 * - 所有GPIO操作均使用HAL API，确保可移植性
 * - 延时函数需要根据实际系统实现
 * - 频率和幅度参数会进行范围检查
 * - 支持向后兼容的函数名
 */
