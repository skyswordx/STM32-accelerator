/**********************************************************
                       康威电子
功能：AD9954驱动的延时函数实现
接口：延时函数接口
时间：2023/06/xx
版本：4.3 - 重构为HAL库版本
作者：康威电子
其他：本程序只供学习使用，盗版必究。

更多电子需求，请到淘宝店，康威电子竭诚为您服务 ^_^
https://kvdz.taobao.com/ 
**********************************************************/
#include "AD9954.h"

/*********************************************************************************************************
** 函数名称 ：void delay_us(uint32_t us)
** 函数功能 ：基于系统时钟的精确微秒延时函数
** 入口参数 ：us - 延时时间（微秒）
** 出口参数 ：无
** 函数说明 ：使用循环计数实现微秒延时，适用于软件SPI时序控制
**           这个函数的精度依赖于系统时钟频率和编译器优化设置
*********************************************************************************************************/
void delay_us(uint32_t us)
{
    // 简化版本：使用循环计数实现微秒延时
    // 这个系数需要根据实际的系统时钟频率调整
    // 对于STM32H7系列，系统时钟通常为400MHz或更高
    // 除以4是因为一个简单的循环大约需要4个时钟周期
    uint32_t count = us * (SystemCoreClock / 1000000 / 4);
    
    while(count--)
    {
        __NOP(); // 空操作，防止编译器优化
    }
}

/*********************************************************************************************************
** 函数名称 ：void delay_us_systick(uint32_t us)
** 函数功能 ：基于SysTick的精确微秒延时函数（备用实现）
** 入口参数 ：us - 延时时间（微秒）
** 出口参数 ：无
** 函数说明 ：使用SysTick计数器实现更精确的延时，但占用资源更多
*********************************************************************************************************/
void delay_us_systick(uint32_t us)
{
    uint32_t ticks;
    uint32_t told, tnow, tcnt = 0;
    uint32_t reload = SysTick->LOAD;
    
    // 计算需要的时钟周期数
    ticks = us * (SystemCoreClock / 1000000);
    
    told = SysTick->VAL;
    
    while (1)
    {
        tnow = SysTick->VAL;
        
        if (tnow != told)
        {
            // SysTick是向下计数的
            if (tnow < told)
            {
                tcnt += told - tnow;
            }
            else
            {
                // 发生了重装载
                tcnt += reload - tnow + told;
            }
            told = tnow;
            
            if (tcnt >= ticks)
            {
                break;
            }
        }
    }
}
